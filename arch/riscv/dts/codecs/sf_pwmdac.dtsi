&sound {
	compatible = "simple-audio-card";
	simple-audio-card,name = "SF-PWMDAC-Sound-Card";
	simple-audio-card,bitclock-master = <&dailink0_master>;
	simple-audio-card,frame-master = <&dailink0_master>;
	simple-audio-card,format = "left_j";
	dailink0_master:simple-audio-card,cpu {
		sound-dai = <&pwmdac>;
	};

	simple-audio-card,codec {
		sound-dai = <&codec>;
	};
};
